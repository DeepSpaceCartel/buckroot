## experiments/helloworld/buildroot-external/configs/helloworld_qemu_aarch64_musl_rootfs_defconfig
```kconfig
BR2_aarch64=y
BR2_TOOLCHAIN_EXTERNAL=y
BR2_TOOLCHAIN_EXTERNAL_BOOTLIN=y
BR2_TOOLCHAIN_EXTERNAL_BOOTLIN_AARCH64_MUSL_STABLE=y
BR2_PER_PACKAGE_DIRECTORIES=y
BR2_REPRODUCIBLE=y
BR2_GLOBAL_PATCH_DIR="board/qemu/patches"
BR2_DOWNLOAD_FORCE_CHECK_HASHES=y
BR2_SYSTEM_DHCP="eth0"
BR2_ROOTFS_POST_IMAGE_SCRIPT="board/qemu/post-image.sh"
BR2_ROOTFS_POST_SCRIPT_ARGS="$(BR2_DEFCONFIG)"
BR2_TARGET_ROOTFS_EXT2=y
BR2_TARGET_ROOTFS_EXT2_4=y
# BR2_TARGET_ROOTFS_TAR is not set
BR2_PACKAGE_HOST_KMOD=y
BR2_PACKAGE_HELLO=y
```

## experiments/helloworld/buildroot-external/package/hello/Config.in
```kconfig
config BR2_PACKAGE_HELLO
	bool "hello"
	help
	  Trivial hello-world C program, shared verbatim with the Tier 1
	  Buck2 migration experiment (see experiments/helloworld/common/hello).
```
